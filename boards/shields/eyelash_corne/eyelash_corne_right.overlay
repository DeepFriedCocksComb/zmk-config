/*
 * Copyright (c) 2022 The ZMK Contributors
 *
 * SPDX-License-Identifier: MIT
 */

#include "eyelash_corne.dtsi"

&kscan0 {
    col-gpios = <&pro_micro 19 GPIO_ACTIVE_HIGH>;
    row-gpios = <&pro_micro 4 GPIO_ACTIVE_HIGH>,
               <&pro_micro 5 GPIO_ACTIVE_HIGH>,
               <&pro_micro 6 GPIO_ACTIVE_HIGH>,
               <&pro_micro 7 GPIO_ACTIVE_HIGH>;
};

&right_encoder {
    status = "okay";
    a-gpios = <&pro_micro 8 (GPIO_ACTIVE_HIGH | GPIO_PULL_UP)>;
    b-gpios = <&pro_micro 9 (GPIO_ACTIVE_HIGH | GPIO_PULL_UP)>;
};
