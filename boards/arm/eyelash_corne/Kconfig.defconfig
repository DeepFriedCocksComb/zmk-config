## boards/arm/eyelash_corne/Kconfig.defconfig
```kconfig
if SHIELD_EYELASH_CORNE_LEFT || SHIELD_EYELASH_CORNE_RIGHT

config ZMK_KEYBOARD_NAME
    default "Eyelash Corne"

config ZMK_SPLIT
    default y

config ZMK_SPLIT_BLE_CENTRAL_PERIPHERALS
    default 1

endif # SHIELD_EYELASH_CORNE_LEFT || SHIELD_EYELASH_CORNE_RIGHT
```

## boards/shields/eyelash_corne/Kconfig.defconfig
```kconfig
if SHIELD_EYELASH_CORNE_LEFT || SHIELD_EYELASH_CORNE_RIGHT

config ZMK_KEYBOARD_NAME
    default "Eyelash Corne"

config ZMK_SPLIT
    default y

endif # SHIELD_EYELASH_CORNE_LEFT || SHIELD_EYELASH_CORNE_RIGHT

config ZMK_SPLIT_BLE_CENTRAL_PERIPHERALS
    default 1

if SHIELD_EYELASH_CORNE_LEFT

config ZMK_SPLIT_ROLE_CENTRAL
    default y

endif # SHIELD_EYELASH_CORNE_LEFT

if SHIELD_EYELASH_CORNE_RIGHT

config ZMK_SPLIT_ROLE_PERIPHERAL
    default y

endif # SHIELD_EYELASH_CORNE_RIGHT
```

## config/west.yml
```yaml
manifest:
  defaults:
    revision: v0.3
  remotes:
    - name: zmkfirmware
      url-base: https://github.com/zmkfirmware
    - name: mctechnology17
      url-base: https://github.com/mctechnology17
    #- name: DeepFriedCocksComb
    #  url-base: https://github.com/DeepFriedCocksComb
    # Additional modules containing boards/shields/custom code can be listed here as well
    # See https://docs.zephyrproject.org/3.2.0/develop/west/manifest.html#projects
  projects:
    - name: zmk
      remote: zmkfirmware
      revision: v0.3.0
      import: app/west.yml
    - name: zmk-new_corne
      url: https://github.com/a741725193/zmk-new_corne
      revision: main
      path: modules/zmk-new_corne
    - name: zmk-nice-oled
      remote: mctechnology17
      revision: main
    #- name: nice-view-gem
    #  remote: DeepFriedCocksComb
    #  revision: main
  self:
    path: config
```
